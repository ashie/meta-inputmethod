## conf/layer.conf
```bitbake
# We have a conf and classes directory, append to BBPATH
BBPATH .= ":${LAYERDIR}"

# We have a recipes directory, add to BBFILES
BBFILES += "${LAYERDIR}/recipes-*/*/*.bb ${LAYERDIR}/recipes-*/*/*.bbappend"

BBFILE_COLLECTIONS += "inputmethod-layer"
BBFILE_PATTERN_inputmethod-layer := "^${LAYERDIR}/"
BBFILE_PRIORITY_inputmethod-layer = "7"
BBFILES_DYNAMIC += " \
    meta-qt5:${LAYERDIR}/dynamic-layers/meta-qt5/recipes-*/*/*.bb \
    meta-qt5:${LAYERDIR}/dynamic-layers/meta-qt5/recipes-*/*/*.bbappend \
"

LAYERVERSION_inputmethod-layer = "1"
LAYERSERIES_COMPAT_inputmethod-layer = "kirkstone"
LAYERDEPENDS_inputmethod = "core openembedded-layer"
```
